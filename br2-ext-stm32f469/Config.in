## br2-ext-stm32f469/Config.in
```kconfig
menu "External options (SS_STM32F469_EXT)"

source "$BR2_EXTERNAL_SS_STM32F469_EXT_PATH/package/hello_world/Config.in"

endmenu
```

## br2-ext-stm32f469/package/hello_world/Config.in
```kconfig
config BR2_PACKAGE_HELLO_WORLD
    bool "hello world (sample app)"
    help
      Simple hello-world style application installed to /usr/bin/hello_world.
```

## br2-ext-stm32f469/package/kmod_hello/Config.in
```kconfig
config BR2_PACKAGE_KMOD_HELLO
    bool "hello kernel module"
    depends on BR2_LINUX_KERNEL      # only make sense if we build a kernel
    help
      Simple out-of-tree hello-world kernel module.
```
